## firmware/zephyr/Kconfig
```kconfig
# Copyright 2025 Morse Micro
# SPDX-License-Identifier: Apache-2.0

config MBEDTLS_ZEPHYR_ENTROPY
	bool

source "Kconfig.zephyr"

config OFFGRID_NRF54_ALL_OFF_SYSTEM_ON
    bool "Use System ON idle in the all-off hardware benchmark"
    default n
    help
      Isolate every external rail and peripheral, then enter tickless System
      ON idle instead of System OFF to compare the MCU/application baseline.

config WIFI_SSID
    string "Wi-Fi SSID of the AP we want to connect to"
    default "MorseMicro"

config WIFI_PSK
    string "Password of the AP we want to connect to"
    default "12345678"

config MQTT_BROKER_ADDR
    string "Address the MQTT broker is running on"
    default "192.168.12.1"

config MQTT_BROKER_PORT
    int "Port the MQTT broker is running on"
    default 1883

choice OFFGRID_NRF54_ROLE
    prompt "Offgrid Tracker nRF54L15 application role"
    default OFFGRID_NRF54_ROLE_COMPANION

config OFFGRID_NRF54_ROLE_COMPANION
    bool "BLE companion and full mesh node"
    help
      Build the phone companion role with BLE provisioning/realtime control,
      mesh peering, BATMAN forwarding, and normal user/device beacons.

config OFFGRID_NRF54_ROLE_SENSOR
    bool "Low-power connectionless HaLow sensor"
    help
      Build a dedicated sensor role. Bluetooth is not required, mesh peering
      and BATMAN are never started, and reports use the connectionless HaLow
      PAwR-like path.

endchoice

config OFFGRID_NRF54_SENSOR_BOOTSTRAP_INTERVAL_SECONDS
    int "Zero-touch request interval"
    range 5 3600
    default 15
    help
      Time between connectionless HaLow provisioning requests.

config OFFGRID_NRF54_MESH_PS_TEST
    bool "Run the nRF54L15 mesh power-save experiment after peering"
    depends on WIFI_MORSEMICRO_EDGEZ_JOIN_ONLY
    depends on WIFI_MORSEMICRO_POWERSAVE
    default n
    help
      Wait for an established 802.11s peer, sample a power-save-off
      baseline, then enable MM6108 dynamic power saving and report MM_BUSY
      duty while the mesh runtime continues to run.

config OFFGRID_NRF54_IMU_ACCEL_ONLY
    bool "Use accelerometer-only low-power IMU FIFO sampling"
    default n
    help
      Keep the gyroscope powered down and collect only accelerometer samples
      through the IMU hardware FIFO. Intended for battery-powered sensors.

config OFFGRID_NRF54_IMU_TIMER_DRAIN
    bool "Drain the IMU FIFO only on the reporting timer wake"
    depends on OFFGRID_NRF54_IMU_ACCEL_ONLY
    default n
    help
      Do not route the FIFO watermark to an MCU interrupt and do not schedule
      periodic FIFO work. The sensor continues batching accelerometer samples
      in hardware while the MCU remains in System ON idle; the application
      drains the FIFO synchronously after the reporting timer wakes it.

config OFFGRID_NRF54_SENSOR_SPI_IRQ_SLEEP_NOPULL
    bool "Remove the sensor SPI IRQ pull-up while transport IRQ is masked"
    depends on OFFGRID_NRF54_SENSOR_HALOW_POWER_SAVE
    default n
    help
      FGH200M power test: the SPI IRQ pin can be low during retained sleep.
      Remove its pull-up only after the SDK masks IRQ, and restore the pull-up
      before checking/unmasking IRQ on wake. Preserve BUSY wake and polarity.

config OFFGRID_NRF54_SENSOR_GPS
    bool "Wake GPS during each low-power sensor reporting cycle"
    default n
    help
      Wake the L76K and wait briefly for a fix before each sensor PAwR report,
      then stop GPS and suspend its UART before returning to tickless sleep.

config OFFGRID_NRF54_SENSOR_HALOW_POWER_SAVE
    bool "Keep HaLow initialized in chip sleep between sensor reports"
    depends on OFFGRID_NRF54_IMU_TIMER_DRAIN
    depends on WIFI_MORSEMICRO_POWERSAVE
    default n
    help
      Boot the MM8108 and initialize its connectionless PAwR radio once, then
      configure chip sleep once, then release the host wake veto between
      reports. CONFIG_PS is not toggled during recurring wake/transmit/sleep
      cycles, avoiding the associated-station transition overhead. The HaLow
      rail and SPI remain enabled, so compare average energy and wake latency
      against full rail cutoff rather than expecting the lowest sleep current.

config OFFGRID_NRF54_SENSOR_PS_PROBE
    bool "Probe retained sleep on the factory stateless wake-test profile"
    depends on OFFGRID_NRF54_SENSOR_HALOW_POWER_SAVE
    default n
    help
      Use an unassociated STA interface for the edgez-wake-test factory profile,
      compare CONFIG_PS modes, and enter/exit firmware long sleep between
      reports. No AP handshake is performed. Logs command status, WAKE output,
      and BUSY when logging is enabled. Disable logging and detach the debugger
      for current measurement. RF wake reception is not established in this mode.

config OFFGRID_NRF54_SENSOR_RX_SLEEP_COMPARE
    bool "Compare awake, ordinary PS, and long-sleep reception once at boot"
    depends on OFFGRID_NRF54_SENSOR_PS_PROBE
    default n
    help
      Hold the factory test radio awake for ten seconds, try an additional
      monitor interface for ten seconds, then release host wake with ordinary
      PS for ten seconds before entering long sleep. Remove the monitor before
      sleeping, or shut down the radio if its removal fails.
      Received test wakes are discarded before the normal sensor loop resumes.
      Read power-save and wake parameters in global and station scope while
      the host is awake, without writing their values. Logging is optional:
      the factory PAwR/TWT test also uses these receive helpers in quiet builds.

config OFFGRID_NRF54_SENSOR_TWT_PROBE
    bool "Probe raw TWT agreements on the unassociated factory STA"
    depends on OFFGRID_NRF54_SENSOR_RX_SLEEP_COMPARE
    default n
    help
      Validate and attempt to install flow 0 with one-second intervals and
      50.176 ms minimum wake duration. Compare announced and unannounced
      requests without AP association. Observe each for ten seconds with
      long sleep disabled, then remove the agreement. A failed cleanup
      forces radio shutdown. This does not establish a working RF schedule.

config OFFGRID_NRF54_SENSOR_TWT_STATE_PROBE
    bool "Compare raw TWT installation across manual station states"
    depends on OFFGRID_NRF54_SENSOR_TWT_PROBE
    default n
    help
      Use Linux force-install request encoding and a fresh STA VIF at each
      stage. Learn the peer MAC from a validated factory wake request, then
      compare no peer, NONE, AUTHENTICATED, ASSOCIATED and AUTHORIZED with
      test AID 1. Stop on rejected transitions. No on-air association is
      performed. Run once per boot and clear context via radio shutdown.

config OFFGRID_NRF54_SENSOR_PAWR_TWT_TEST
    bool "Negotiate a bounded experimental TWT schedule over PAwR"
    depends on OFFGRID_NRF54_SENSOR_TWT_STATE_PROBE
    default n
    help
      Factory-only one-shot experiment with HC33. Bootstrap using monitor RX,
      authorize the peer locally, query radio TSF, negotiate and install flow 0.
      Remove monitor/scan before the retained session. Reject stale/mismatched
      replies and excessive timing uncertainty. Send periodic sensor reports
      at the configured bootstrap interval while retaining the agreement.
      Reset to retry after setup failure; no automatic rebootstrap timer.
      Shut down the radio at failure. Does not prove RF sleep.

config OFFGRID_NRF54_SENSOR_DTIM40_TEST
    bool "Compare DTIM reception without installing native TWT"
    depends on OFFGRID_NRF54_SENSOR_PAWR_TWT_TEST
    depends on !OFFGRID_NRF54_SENSOR_TWT_NATIVE_MESH_TEST
    default n
    help
      Factory AP/STA experiment: retain the PAwR control session, but use
      TIM mode and the configured listen interval instead of a TWT agreement.
      Requires matching HC33 AP beacons: serial '2' (20) or '4' (40), then 'c'.
      This manually creates station state; it is not a full association test.

config OFFGRID_NRF54_SENSOR_DTIM_PERIOD
    int "Beacon intervals per DTIM in the factory comparison"
    depends on OFFGRID_NRF54_SENSOR_DTIM40_TEST
    range 1 255
    default 40

config OFFGRID_NRF54_SENSOR_DTIM_DYNAMIC_PS_TIMEOUT_MS
    int "Dynamic PS timeout for the DTIM comparison (ms)"
    depends on OFFGRID_NRF54_SENSOR_DTIM40_TEST
    range 20 1000
    default 100

config OFFGRID_NRF54_SENSOR_DTIM_PS_AUDIT
    bool "Capture DTIM PS parameters and a second sleep snapshot"
    depends on OFFGRID_NRF54_SENSOR_DTIM40_TEST && OFFGRID_NRF54_SENSOR_TWT_MAC_SNAPSHOT
    default n

config OFFGRID_NRF54_SENSOR_TWT_UNANNOUNCED_TEST
    bool "Use an unannounced agreement in the factory PAwR/TWT experiment"
    depends on OFFGRID_NRF54_SENSOR_PAWR_TWT_TEST
    default n
    help
      Set only the unannounced bit in the installed requester agreement.
      Compare firmware service-period counters with the announced baseline;
      command acceptance and application RX do not establish RF sleep.

config OFFGRID_NRF54_SENSOR_TWT_NATIVE_MESH_TEST
    bool "Probe native TWT on a MESH VIF without a STA VIF or AP timing"
    depends on OFFGRID_NRF54_SENSOR_PAWR_TWT_TEST
    default n
    help
      Keep the radio backend's native MESH interface. Do not create a STA
      or monitor interface, scan, set BSSID, or configure STA listen/non-TIM
      behavior. Start beaconless MESH and test native validate/direct-install
      commands with PS offload enabled. The default has no peer authorization;
      a separate opt-in peer test compares manually registered mesh peers.
      Retain diagnostics. Firmware support is not assumed.

config OFFGRID_NRF54_SENSOR_TWT_NATIVE_MESH_PEER_TEST
    bool "Add a static peer record before the native MESH TWT probe"
    depends on OFFGRID_NRF54_SENSOR_TWT_NATIVE_MESH_TEST && OFFGRID_NRF54_SENSOR_TWT_STATE_PROBE
    default n
    help
      Compare the bare MESH VIF with manually registered peer states, as used
      by mac80211 for mesh peers. No STA VIF or on-air association is created.
      This is a stateful peer diagnostic, not a stateless operating mode.

config OFFGRID_NRF54_SENSOR_TWT_BEACON_SYNC_TEST
    bool "Allow native BSS timing seed before installing TWT (factory test)"
    depends on OFFGRID_NRF54_SENSOR_PAWR_TWT_TEST
    default n
    help
      Wait 300 ms after installing the known peer's STA state so an opt-in
      HC33 100-TU S1G beacon can seed firmware TSF before TWT negotiation.
      No scan, discovery transmission, periodic calibration or LED activity.

config OFFGRID_NRF54_SENSOR_TWT_AP_BSSID_TEST
    bool "Use AP-compatible BSSID fields for factory PAwR/TWT test"
    depends on OFFGRID_NRF54_SENSOR_TWT_BEACON_SYNC_TEST
    default n
    help
      Bootstrap Public Action uses the destination or wildcard BSSID.
      Negotiated TWT control uses the known peer BSSID. This affects only
      the factory experiment with HC33's explicit native AP timing mode.

config OFFGRID_NRF54_SENSOR_TWT_MAC_SNAPSHOT
    bool "Capture MAC and Apps-core sleep diagnostics once after TWT setup"
    depends on OFFGRID_NRF54_SENSOR_PAWR_TWT_TEST
    default n
    help
      After 15 quiet seconds, request MAC and Apps-core statistics once and
      retain the raw responses in RAM for debugger retrieval. These commands wake the host
      transport; it is not a sleep-current measurement. No counter reset,
      USER packets, repeated polling, or changes to the STA/TWT configuration.

config OFFGRID_NRF54_SENSOR_TWT_FORCE_SNOOZE
    bool "Probe native firmware SNOOZE while retaining the TWT schedule"
    depends on OFFGRID_NRF54_SENSOR_PAWR_TWT_TEST
    default n
    help
      Factory experiment using Linux Morse FORCE_POWER_MODE (0x48), mode 0.
      The SDK does not expose this command; firmware acceptance is checked.
      Never selects deep sleep or hibernation, removes STA/TWT, cuts the rail,
      or substitutes MCU timer wake. Current and RF wake require external tests.

config OFFGRID_NRF54_SENSOR_TWT_REMOVE_COMPARE
    bool "Compare retained station power with and without a TWT agreement"
    depends on OFFGRID_NRF54_SENSOR_PAWR_TWT_TEST
    default n
    help
      Factory diagnostic: after negotiation, release host wake for 90 seconds,
      then remove only flow 0 and release host wake again. Retain the radio
      rail, station state and PS configuration until reset. No USER traffic
      or periodic reports are processed during this comparison. Measure power
      externally with the debugger disconnected. Command failure or USER
      traffic marks the comparison invalid and holds the radio for inspection.

config OFFGRID_NRF54_SENSOR_TWT_STATION_REMOVE_COMPARE
    bool "Compare retained station versus station removed after TWT removal"
    depends on OFFGRID_NRF54_SENSOR_TWT_REMOVE_COMPARE
    default n
    help
      Start the comparison with flow 0 already removed. Keep the authorized
      station for 90 seconds, then descend through states 3, 2, 1 and 0.
      Release host wake and hold until reset, keeping the rail, VIF and
      CONFIG_PS settings. This replaces the TWT-installed first phase.

config OFFGRID_NRF54_SENSOR_PAWR_BULK_TEST
    bool "Run the connectionless PAwR bulk-transfer test"
    depends on OFFGRID_NRF54_ROLE_SENSOR
    depends on WIFI_MORSEMICRO_EDGEZ_JOIN_ONLY
    default n
    help
      Continuously transmit deterministic 32 KiB and 64 KiB test streams
      through the bounded producer ring. Large transfers use bitmap block
      acknowledgements and selective retransmission; ordinary sensor reports
      continue to use the existing per-request payload-hash acknowledgement.
      This is a diagnostic image, not the normal low-power telemetry path.
```
