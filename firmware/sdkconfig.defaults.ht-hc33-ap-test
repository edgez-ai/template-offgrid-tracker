## firmware/sdkconfig.defaults.ht-hc33-ap-test
```kconfig
CONFIG_IDF_TARGET="esp32s3"
CONFIG_OFFGRID_HT_HC33_AP_TEST=y
CONFIG_ESPTOOLPY_FLASHSIZE_16MB=y
CONFIG_PARTITION_TABLE_CUSTOM=y
CONFIG_PARTITION_TABLE_CUSTOM_FILENAME="partitions.ht-hc33-ap-test.csv"
CONFIG_ESP_MAIN_TASK_STACK_SIZE=12288
CONFIG_FREERTOS_HZ=1000
CONFIG_SPIRAM=y
CONFIG_SPIRAM_MODE_OCT=y
CONFIG_SPIRAM_SPEED_80M=y
CONFIG_SPIRAM_BOOT_INIT=y
CONFIG_SPIRAM_USE_MALLOC=y
CONFIG_SPIRAM_MALLOC_ALWAYSINTERNAL=16384
CONFIG_SPIRAM_MALLOC_RESERVE_INTERNAL=32768
CONFIG_HALOW_COUNTRY_CODE="US"
CONFIG_HALOW_PS_MODE=n
CONFIG_MM_CHIP_MM6108=y
CONFIG_MM_BCF_FILE="bcf_fgh100mhaamd.mbin"
CONFIG_MM_RESET_N=8
CONFIG_MM_WAKE=9
CONFIG_MM_BUSY=7
CONFIG_MM_SPI_SCK=4
CONFIG_MM_SPI_MOSI=3
CONFIG_MM_SPI_MISO=5
CONFIG_MM_SPI_CS=2
CONFIG_MM_SPI_IRQ=6
CONFIG_MMPKTMEM_TX_POOL_N_BLOCKS=48
CONFIG_MMPKTMEM_RX_POOL_N_BLOCKS=64
```

## firmware/sdkconfig.defaults.ht-hc33-ap-test.local.example
```kconfig
CONFIG_OFFGRID_AP_TEST_SSID="EdgeZ-HaLow"
CONFIG_OFFGRID_AP_TEST_PSK="replace-with-local-ap-password"
```
