/* Factory-only application-thread experiment. RX callbacks only enqueue.
 * Included after raw command helpers to keep the production sensor path small. */
/* Passive test evidence survives an RTT disconnect. Read these symbols from
 * the exact flashed ELF after the quiet interval; they never poll or wake RF.
 * Counts establish application behavior, not radio sleep or supply current. */
static volatile uint32_t sensor_twt_test_session;
static volatile uint32_t sensor_twt_test_active;
static volatile uint32_t sensor_twt_test_user_rx;
static volatile uint32_t sensor_twt_test_ack_completed;
static volatile uint32_t sensor_twt_test_ack_failed;
static volatile uint32_t sensor_twt_test_feedback_skipped;
static volatile uint32_t sensor_twt_test_led_on;
static volatile uint32_t sensor_twt_test_led_off;
static volatile uint32_t sensor_twt_test_host_released;
/* Opt-in debugger control: capture only after real USER traffic, while that
 * traffic already holds host wake. Zero leaves the one-shot behavior intact. */
#if defined(CONFIG_OFFGRID_NRF54_SENSOR_TWT_MAC_SNAPSHOT)
static volatile uint32_t sensor_twt_test_capture_after_user;
#endif

static uint64_t sensor_twt_now_us(void)
{
    return k_ticks_to_us_floor64(k_uptime_ticks());
}

#if defined(CONFIG_OFFGRID_NRF54_SENSOR_TWT_BEACON_SYNC_TEST)
static void sensor_twt_set_bssid(void)
{
    /* Linux BSS_CHANGED_BSSID -> BSSID_SET. SDK ABI 57.3 has no wrapper;
     * retain the firmware status so unsupported commands are explicit. */
    struct __packed {
        struct morse_cmd_header hdr;
        uint8_t bssid[6];
    } cmd = MORSE_COMMAND_INIT(cmd, 0x0052, mesh_runtime.umac.vif_id);
    memcpy(cmd.bssid, sensor_probe_peer_mac, sizeof(cmd.bssid));
    struct { struct morse_cmd_resp resp; uint8_t extra[112]; } reply = {0};
    uint32_t bytes = sizeof(reply);
    enum mmwlan_status sdk = mmdrv_execute_command((uint8_t *)&cmd, (uint8_t *)&reply, &bytes);
    bool valid = (sdk == MMWLAN_SUCCESS || sdk == MMWLAN_COMMAND_ERROR) &&
        bytes >= sizeof(reply.resp) && bytes <= sizeof(reply) &&
        le16toh(reply.resp.hdr.message_id) == 0x0052 &&
        le16toh(reply.resp.hdr.vif_id) == mesh_runtime.umac.vif_id;
    LOG_INF("PAWR_TWT BSSID_SET cmd=0x0052 peer=%02x:%02x:%02x:%02x:%02x:%02x sdk=%d valid=%u fw=%d bytes=%u",
        cmd.bssid[0], cmd.bssid[1], cmd.bssid[2], cmd.bssid[3], cmd.bssid[4], cmd.bssid[5],
        sdk, valid, valid ? (int32_t)le32toh(reply.resp.status) : INT32_MIN, bytes);
}
#endif

static bool sensor_twt_ps_contract(uint16_t command_id)
{
    struct morse_cmd_req_li_sleep li = MORSE_COMMAND_INIT(li,
        MORSE_CMD_ID_LI_SLEEP, mesh_runtime.umac.vif_id,
        .listen_interval = htole32(2));
    struct morse_cmd_req_get_set_generic_param non_tim = MORSE_COMMAND_INIT(non_tim,
        MORSE_CMD_ID_GET_SET_GENERIC_PARAM, mesh_runtime.umac.vif_id,
        .param_id = htole32(MORSE_CMD_PARAM_ID_NON_TIM_MODE),
        .action = htole32(MORSE_CMD_PARAM_ACTION_SET), .value = htole32(1));
    struct { struct morse_cmd_resp resp; uint8_t extra[112]; } reply = {0};
    uint32_t len = sizeof(reply);
    enum mmwlan_status sdk = mmdrv_execute_command(
        command_id == MORSE_CMD_ID_LI_SLEEP ? (uint8_t *)&li : (uint8_t *)&non_tim,
        (uint8_t *)&reply, &len);
    bool valid = (sdk == MMWLAN_SUCCESS || sdk == MMWLAN_COMMAND_ERROR) &&
        len >= sizeof(reply.resp) && len <= sizeof(reply) &&
        le16toh(reply.resp.hdr.message_id) == command_id &&
        le16toh(reply.resp.hdr.vif_id) == mesh_runtime.umac.vif_id;
    LOG_INF("PAWR_TWT PS_CONTRACT cmd=0x%04x sdk=%d valid=%u fw=%d bytes=%u",
        command_id, sdk, valid,
        (int)(valid ? (int32_t)le32toh(reply.resp.status) : INT32_MIN), len);
    return valid && sdk == MMWLAN_SUCCESS && le32toh(reply.resp.status) == 0;
}

static bool sensor_twt_send_to(const struct edgez_pawr_twt *msg, const uint8_t peer[6])
{
    uint8_t payload[EDGEZ_PAWR_TWT_LENGTH];
    uint8_t packet[EDGEZ_PAWR_HEADER_LENGTH + EDGEZ_PAWR_TWT_TRAILER_LENGTH];
    uint8_t frame[EDGEZ_PAWR_ACTION_HEADER_LENGTH + sizeof(packet)];
    size_t packet_len, frame_len;
    if (msg->kind == EDGEZ_PAWR_TWT_HIT) {
        if (!edgez_pawr_encode_response(packet, sizeof(packet),
                edgez_pawr_payload_hash(sensor_remote_wake_payload, sizeof(sensor_remote_wake_payload)),
                mesh_runtime.config.compressed_ssid, &packet_len) ||
            !edgez_pawr_twt_append(packet, sizeof(packet), &packet_len, msg)) return false;
    } else if (!edgez_pawr_twt_encode(payload, sizeof(payload), msg) ||
        !edgez_pawr_encode_typed_request(packet, sizeof(packet), EDGEZ_PAWR_REQUEST_TWT_CONTROL,
            ++pawr_request_id, 0, mesh_runtime.config.compressed_ssid,
            payload, sizeof(payload), &packet_len)) return false;
    if (!edgez_pawr_encode_action_frame(frame, sizeof(frame), pawr_sequence_number++,
            mesh_runtime.radio_info.mac_addr, peer,
            packet, packet_len, &frame_len)) return false;
#if defined(CONFIG_OFFGRID_NRF54_SENSOR_TWT_AP_BSSID_TEST)
    memcpy(frame + 16, peer, 6);
#endif
    const struct edgez_umac_tx_request tx = {
        .token = ++pawr_tx_token, .frame = frame, .frame_length = frame_len,
        .frame_type = EDGEZ_UMAC_TX_MANAGEMENT, .tid = 8, .mcs = 0,
        .attempts = 1, .bandwidth_mhz = 1, .no_ack = true, .immediate_status = true,
    };
    bool feedback = msg->kind == EDGEZ_PAWR_TWT_HIT;
    if (feedback) {
        k_sem_reset(&sensor_twt_tx_done);
        atomic_clear(&sensor_twt_tx_failed);
        sensor_twt_tx_token = tx.token;
        atomic_set(&sensor_twt_tx_armed, 1);
    }
    bool submitted = edgez_umac_transmit(&mesh_runtime.umac, &tx) == EDGEZ_UMAC_OK;
    if (!feedback) return submitted;
    /* Submission is asynchronous. Reconfigure PS only once this ACK has
     * completed, never from the driver callback or while its TX is queued. */
    bool completed = submitted && k_sem_take(&sensor_twt_tx_done, K_MSEC(200)) == 0;
    atomic_clear(&sensor_twt_tx_armed);
    bool failed = atomic_get(&sensor_twt_tx_failed);
    if (completed && !failed) ++sensor_twt_test_ack_completed;
    else ++sensor_twt_test_ack_failed;
    LOG_INF("PAWR_TWT ACK_TX token=%u submitted=%u completed=%u failed=%u",
        (unsigned)tx.token, submitted, completed, failed);
    return completed && !failed;
}

static bool sensor_twt_send(const struct edgez_pawr_twt *msg)
{
    return sensor_twt_send_to(msg, sensor_probe_peer_mac);
}

static bool sensor_twt_wait(const struct edgez_pawr_twt *offer, uint8_t kind,
                            struct sensor_twt_event *event, int timeout_ms)
{
    int64_t deadline = k_uptime_get() + timeout_ms;
    while (k_uptime_get() < deadline) {
        if (k_msgq_get(&sensor_twt_queue, event, K_MSEC(deadline - k_uptime_get())) != 0)
            return false;
        if (event->msg.kind == kind && memcmp(event->peer, sensor_probe_peer_mac, 6) == 0 &&
            edgez_pawr_twt_same_schedule(offer, &event->msg) &&
            event->msg.round_trip_us == offer->round_trip_us && !event->msg.sequence)
            return true;
    }
    return false;
}

#if defined(CONFIG_OFFGRID_NRF54_SENSOR_TWT_MAC_SNAPSHOT)
#include "edgez_morse_diagnostics.h"
/* SDK mmwlan_get_morse_stats() uses 1600 bytes. Keep the complete command
 * response so the host decoder can validate its header and payload bounds. */
static uint8_t sensor_twt_mac_snapshot[EDGEZ_MORSE_MAC_DIAGNOSTICS_CAPACITY] __aligned(4);
static volatile uint32_t sensor_twt_mac_snapshot_length;
static volatile int32_t sensor_twt_mac_snapshot_status = -1;
/* Apps-core statistics include firmware sleep counts and cumulative sleep
 * time, unlike MAC-only service-period counters. Read once with the existing
 * diagnostic snapshot; measurement builds compile both queries out. */
static uint8_t sensor_twt_sleep_snapshot[4096] __aligned(4);
static volatile uint32_t sensor_twt_sleep_snapshot_length;
static volatile int32_t sensor_twt_sleep_snapshot_status = -1;

static const struct gpio_dt_spec sensor_twt_busy_pin =
    GPIO_DT_SPEC_GET(DT_NODELABEL(morse_wifi), busy_gpios);
static const struct gpio_dt_spec sensor_twt_wake_pin =
    GPIO_DT_SPEC_GET(DT_NODELABEL(morse_wifi), wakeup_gpios);
static struct gpio_callback sensor_twt_busy_callback;
static atomic_t sensor_twt_busy_edges;
static bool sensor_twt_busy_observer_ready;

static void sensor_twt_observe_busy(const struct device *port,
                                  struct gpio_callback *cb, uint32_t pins)
{
    ARG_UNUSED(port);
    ARG_UNUSED(cb);
    if (pins & BIT(sensor_twt_busy_pin.pin)) atomic_inc(&sensor_twt_busy_edges);
}

static void sensor_twt_busy_observer_start(void)
{
    /* Observe the driver's existing BUSY callback only. Do not configure a
     * pin, enable an interrupt, poll, or generate a driver wake request. */
    if (sensor_twt_busy_observer_ready) return;
    gpio_init_callback(&sensor_twt_busy_callback, sensor_twt_observe_busy,
                      BIT(sensor_twt_busy_pin.pin));
    int rc = gpio_add_callback(sensor_twt_busy_pin.port, &sensor_twt_busy_callback);
    sensor_twt_busy_observer_ready = rc == 0;
    LOG_INF("PAWR_TWT BUSY_OBSERVER register=%d pin=%u; existing interrupt only",
        rc, sensor_twt_busy_pin.pin);
}

static void sensor_twt_log_busy(const char *stage)
{
    LOG_INF("PAWR_TWT BUSY_OBSERVER stage=%s edges=%u busy=%d wake=%d",
        stage, (unsigned)atomic_get(&sensor_twt_busy_edges),
        gpio_pin_get_dt(&sensor_twt_busy_pin), gpio_pin_get_dt(&sensor_twt_wake_pin));
}

static void sensor_twt_capture_mac(void)
{
    sensor_twt_log_busy("before-snapshot");
    uint32_t bytes = 0;
    int rc = edgez_morse_read_mac_diagnostics(sensor_twt_mac_snapshot,
        sizeof(sensor_twt_mac_snapshot), &bytes);
    sensor_twt_mac_snapshot_length = bytes;
    sensor_twt_mac_snapshot_status = rc;
    struct morse_cmd_req cmd = MORSE_COMMAND_INIT(cmd,
        MORSE_CMD_ID_HOST_STATS_LOG, UINT16_MAX);
    uint32_t sleep_bytes = sizeof(sensor_twt_sleep_snapshot);
    enum mmwlan_status status = mmdrv_execute_command((uint8_t *)&cmd,
        sensor_twt_sleep_snapshot, &sleep_bytes);
    sensor_twt_sleep_snapshot_length = sleep_bytes <= sizeof(sensor_twt_sleep_snapshot) ? sleep_bytes : 0;
    sensor_twt_sleep_snapshot_status = status;
    LOG_INF("PAWR_TWT MAC_SNAPSHOT sdk=%d bytes=%u; one-shot protocol diagnostic, not a power measurement",
        rc, bytes);
    LOG_INF("PAWR_TWT SLEEP_SNAPSHOT sdk=%d bytes=%u; firmware counters, not a current measurement",
        status, sleep_bytes);
    sensor_twt_log_busy("after-snapshot");
}
#endif

#if defined(CONFIG_OFFGRID_NRF54_SENSOR_TWT_FORCE_SNOOZE)
static void sensor_twt_force_snooze(void)
{
    static bool unsupported;
    if (unsupported) return;
    /* Linux morse_commands.h: FORCE_POWER_MODE=0x48, SNOOZE=0.
     * SDK ABI 57.3 has no wrapper, so treat support as a capability probe. */
    struct __packed {
        struct morse_cmd_header hdr;
        uint32_t mode;
    } cmd = MORSE_COMMAND_INIT(cmd, 0x0048, mesh_runtime.umac.vif_id,
        .mode = htole32(0));
    struct { struct morse_cmd_resp resp; uint8_t extra[112]; } reply = {0};
    uint32_t bytes = sizeof(reply);
    enum mmwlan_status rc = mmdrv_execute_command((uint8_t *)&cmd, (uint8_t *)&reply, &bytes);
    bool valid = (rc == MMWLAN_SUCCESS || rc == MMWLAN_COMMAND_ERROR) &&
        bytes >= sizeof(reply.resp) && bytes <= sizeof(reply) &&
        le16toh(reply.resp.hdr.message_id) == 0x0048 &&
        le16toh(reply.resp.hdr.vif_id) == mesh_runtime.umac.vif_id;
    int32_t status = valid ? (int32_t)le32toh(reply.resp.status) : INT32_MIN;
    bool accepted = valid && rc == MMWLAN_SUCCESS && status == 0;
    LOG_INF("PAWR_TWT FORCE_SNOOZE cmd=0x0048 mode=0 sdk=%d valid=%u fw=%d accepted=%u; STA/TWT retained; RF sleep unverified",
        rc, valid, (int)status, accepted);
    /* Never fall through to rail-cutoff cleanup when capability is absent. */
    unsupported = !accepted;
}
#endif

#if defined(CONFIG_OFFGRID_NRF54_SENSOR_TWT_REMOVE_COMPARE)
/* Diagnostic state for read-only inspection, never a claim about RF sleep:
 * 0 = not started, 1 = installed, 2 = TWT removed, 3 = invalid,
 * 4 = TWT and station removed. */
static volatile uint32_t sensor_twt_compare_phase;

static bool sensor_twt_compare_quiet_window(void)
{
    struct sensor_twt_event event;
    int64_t until = k_uptime_get() + 90000;
    for (;;) {
        int64_t remaining = until - k_uptime_get();
        if (remaining <= 0) return true;
        if (k_msgq_get(&sensor_twt_queue, &event, K_MSEC(remaining)) == 0) {
            LOG_ERR("TWT_COMPARE unexpected RX kind=%u; comparison invalid", event.msg.kind);
            return false;
        }
    }
}

static void sensor_twt_compare_hold(void)
{
    struct sensor_twt_event event;
#if !defined(CONFIG_OFFGRID_NRF54_SENSOR_TWT_STATION_REMOVE_COMPARE)
    if (mmdrv_set_wake_enabled(false) != MMWLAN_SUCCESS) goto invalid;
    sensor_halow_sleep_allowed = true;
    sensor_twt_compare_phase = 1;
    LOG_INF("TWT_COMPARE A installed duration_ms=90000 rail=on host_wake=released; external measurement only");
    if (!sensor_twt_compare_quiet_window()) goto invalid;
#endif
    if (mmdrv_set_wake_enabled(true) != MMWLAN_SUCCESS) goto invalid;
    sensor_halow_sleep_allowed = false;
    if (!sensor_probe_twt_at(MORSE_CMD_ID_TWT_AGREEMENT_REMOVE, 0x1420, 0)) goto invalid;
    if (mmdrv_set_wake_enabled(false) != MMWLAN_SUCCESS) goto invalid;
    sensor_halow_sleep_allowed = true;
    sensor_twt_compare_phase = 2;
#if defined(CONFIG_OFFGRID_NRF54_SENSOR_TWT_STATION_REMOVE_COMPARE)
    LOG_INF("TWT_COMPARE B TWT_removed station=authorized duration_ms=90000 rail=on host_wake=released");
    if (!sensor_twt_compare_quiet_window()) goto invalid;
    if (mmdrv_set_wake_enabled(true) != MMWLAN_SUCCESS) goto invalid;
    sensor_halow_sleep_allowed = false;
    /* Same peer/AID/VIF, descending through the SDK station states. No
     * interface recreation, CONFIG_PS rewrite or rail cycling here. */
    /* Wire values from SDK internal/mmdrv.h: ASSOCIATED=3, NOTEXIST=0. */
    for (int state = 3; state >= 0; --state) {
        if (!sensor_probe_sta_state((uint16_t)state)) goto invalid;
    }
    if (mmdrv_set_wake_enabled(false) != MMWLAN_SUCCESS) goto invalid;
    sensor_halow_sleep_allowed = true;
    sensor_twt_compare_phase = 4;
    LOG_INF("TWT_COMPARE C TWT_removed station=notexist hold_until_reset rail=on host_wake=released CONFIG_PS_unchanged");
#else
    LOG_INF("TWT_COMPARE B removed hold_until_reset rail=on host_wake=released; station/CONFIG_PS unchanged");
#endif
    for (;;) {
        if (k_msgq_get(&sensor_twt_queue, &event, K_FOREVER) == 0) {
            LOG_ERR("TWT_COMPARE unexpected RX kind=%u; comparison invalid", event.msg.kind);
            goto invalid;
        }
    }
 invalid:
    sensor_twt_compare_phase = 3;
    sensor_halow_sleep_allowed = mmdrv_set_wake_enabled(false) == MMWLAN_SUCCESS;
    LOG_ERR("TWT_COMPARE INVALID; retaining radio until reset; discard power comparison");
    /* Do not enter normal failure cleanup: rail cutoff would make a failed
     * command appear to have fixed native sleep. */
    for (;;) k_sleep(K_FOREVER);
}
#endif

static bool sensor_twt_pawr_test(void)
{
    /* One initial PAwR exchange per boot. The sensor caller parks after
     * failure; this test never wakes periodically to report or renegotiate. */
    bool installed = false;
    struct sensor_twt_event event;
    struct edgez_pawr_twt offer = {0};
    unsigned inside = 0, outside = 0;
    uint64_t offered_at = 0;
    uint64_t led_until = 0;
    uint64_t last_probe_us = 0;
    bool host_released = false;
    k_spinlock_key_t key = k_spin_lock(&sensor_pawr_lock);
    bool seeded = sensor_twt_seed_valid;
    if (seeded) event = sensor_twt_seed;
    sensor_twt_seed_valid = false;
    k_spin_unlock(&sensor_pawr_lock, key);
    if (!seeded) {
        LOG_INF("PAWR_TWT no session in PAwR ACK; reset required to retry");
        return false;
    }
    sensor_twt_test_active = 0;
    sensor_twt_test_session = event.msg.session;
    sensor_twt_test_user_rx = 0;
    sensor_twt_test_ack_completed = 0;
    sensor_twt_test_ack_failed = 0;
    sensor_twt_test_feedback_skipped = 0;
    sensor_twt_test_led_on = 0;
    sensor_twt_test_led_off = 0;
    sensor_twt_test_host_released = 0;
    memcpy(sensor_probe_peer_mac, event.peer, 6);
    atomic_set(&sensor_probe_peer_seen, 1);
    offer = (struct edgez_pawr_twt) {
        .kind = EDGEZ_PAWR_TWT_OFFER, .session = event.msg.session,
        .interval_us = 2000000, .duration_us = 50176, .lease_ms = 0,
    };
    LOG_INF("PAWR_TWT session=%u from PAwR ACK; no discovery", offer.session);
#if defined(CONFIG_OFFGRID_NRF54_SENSOR_TWT_MAC_SNAPSHOT)
    sensor_twt_busy_observer_start();
    sensor_twt_log_busy("setup");
#endif
    if (mmdrv_set_wake_enabled(true) != MMWLAN_SUCCESS ||
        !sensor_probe_long_sleep(false) || !sensor_probe_config_ps(false, false)) goto done;
    k_msgq_purge(&sensor_twt_queue);
    /* Match umac_connection_set_bss_cfg(): station BSS configuration uses
     * zero DTIM/CSSID, unlike the mesh/AP configuration used at radio start.
     * PAwR's application-level CSSID remains in mesh_runtime.config. */
    int bss_status = mesh_runtime.umac.driver->configure_bss(
        mesh_runtime.umac.driver_ctx, mesh_runtime.umac.vif_id,
        mesh_runtime.config.beacon_interval_tu, 0, 0);
    LOG_INF("PAWR_TWT STA_BSS beacon_tu=%u dtim=0 cssid=0 sdk=%d",
        mesh_runtime.config.beacon_interval_tu, bss_status);
    if (bss_status != 0) goto done;
#if defined(CONFIG_OFFGRID_NRF54_SENSOR_TWT_BEACON_SYNC_TEST)
    sensor_twt_set_bssid();
#endif
    /* The SDK programs LI_SLEEP at interface creation, then non-TIM after
     * association. LI_SLEEP counts configured beacon intervals; this does
     * not change the separately negotiated 2.000 s TWT agreement. */
    if (!sensor_twt_ps_contract(MORSE_CMD_ID_LI_SLEEP)) goto done;
    for (uint16_t state = 1; state <= 4; ++state) {
        if (!sensor_probe_sta_state(state)) goto done;
        if (state == 3 && !sensor_twt_ps_contract(MORSE_CMD_ID_GET_SET_GENERIC_PARAM)) goto done;
    }
#if defined(CONFIG_OFFGRID_NRF54_SENSOR_TWT_BEACON_SYNC_TEST)
    LOG_INF("PAWR_TWT native beacon sync opportunity wait_ms=300; known peer, no discovery");
    k_msleep(300);
#endif
    /* Match mmdrv_set_chip_power_save_enabled(): delegate dynamic PS to
     * firmware. Linux uses PS_NULLFUNC_STACK when offload is disabled;
     * this stateless host does not implement that PM-null state machine. */
    if (!sensor_probe_config_ps(true, true)) goto done;
    /* Clock mapping must be supported and advancing before any install. */
    uint64_t previous;
    if (!sensor_probe_get_tsf(&previous)) goto done;
    k_msleep(20);
    bool accepted = false;
    for (unsigned attempt = 0; attempt < 4; ++attempt) {
        offered_at = sensor_twt_now_us();
        if (!sensor_probe_get_tsf(&offer.reference_tsf) || offer.reference_tsf <= previous) goto done;
        previous = offer.reference_tsf;
        offer.target_tsf = offer.reference_tsf + 3000000;
        offer.round_trip_us = 0;
        LOG_INF("PAWR_TWT offer session=%u attempt=%u target=%llu interval_us=%u duration_us=%u",
            offer.session, attempt, (unsigned long long)offer.target_tsf,
            offer.interval_us, offer.duration_us);
        if (!sensor_twt_send(&offer)) goto done;
        if (!sensor_twt_wait(&offer, EDGEZ_PAWR_TWT_ACCEPT, &event, 400)) continue;
        uint64_t rtt = event.received_us - offered_at;
        if (!rtt || rtt > 30000) {
            LOG_WRN("PAWR_TWT timing rejected round_trip_us=%llu", (unsigned long long)rtt);
            continue;
        }
        offer.round_trip_us = (uint32_t)rtt;
        accepted = true;
        break;
    }
    if (!accepted) { LOG_ERR("PAWR_TWT accept timeout or timing uncertainty"); goto done; }
    /* Match SDK requester/SUGGEST installation for a negotiated explicit TSF:
     * request=1, setup=SUGGEST(1), implicit=1, announced flow 0, exponent=5.
     * Period remains 62500 << 5 = 2 seconds. */
    uint16_t request_type = 0x1423;
#if defined(CONFIG_OFFGRID_NRF54_SENSOR_TWT_UNANNOUNCED_TEST)
    request_type |= BIT(6);
#endif
    if (!sensor_probe_twt_at(MORSE_CMD_ID_TWT_AGREEMENT_VALIDATE, request_type, offer.target_tsf)) goto done;
    installed = sensor_probe_twt_at(MORSE_CMD_ID_TWT_AGREEMENT_INSTALL, request_type, offer.target_tsf);
    if (!installed) goto done;
    offer.kind = EDGEZ_PAWR_TWT_COMMIT;
    bool ready = false;
    for (unsigned retry = 0; retry < 3; ++retry) {
        if (!sensor_twt_send(&offer)) goto done;
        if (sensor_twt_wait(&offer, EDGEZ_PAWR_TWT_READY, &event, 200)) { ready = true; break; }
    }
    if (!ready) { LOG_ERR("PAWR_TWT ready timeout"); goto done; }
    edgez_gps_stop();
    /* Release host wake after setup. Only actual PAwR USER traffic supplies
     * timing samples; silence does not expire the installed agreement. */
    sensor_led_set_awake(false);
    uint64_t expires = offer.lease_ms ? offered_at + 3000000 + (uint64_t)offer.lease_ms * 1000 : UINT64_MAX;
    uint64_t release_at = sensor_twt_now_us();
    sensor_twt_test_active = 1;
#if defined(CONFIG_OFFGRID_NRF54_SENSOR_TWT_MAC_SNAPSHOT)
    uint64_t snapshot_at = release_at + 15000000;
#endif
    LOG_INF("PAWR_TWT ACTIVE session=%u round_trip_us=%u lease_ms=%u monitor=0 scan=0 long_sleep=0 awake_control_ms=0 calibration=piggyback",
        offer.session, offer.round_trip_us, offer.lease_ms);
#if defined(CONFIG_OFFGRID_NRF54_SENSOR_TWT_REMOVE_COMPARE)
    sensor_twt_compare_hold();
#endif
    for (;;) {
        uint64_t now = sensor_twt_now_us();
#if defined(CONFIG_OFFGRID_NRF54_SENSOR_TWT_MAC_SNAPSHOT)
        if (snapshot_at != UINT64_MAX && now >= snapshot_at) {
            snapshot_at = UINT64_MAX;
            sensor_twt_capture_mac();
            now = sensor_twt_now_us();
        }
#endif
        if (led_until && now >= led_until) {
            sensor_led_set_awake(false);
            LOG_INF("PAWR_TWT LED off; five-second USER wake window ended");
            led_until = 0;
            ++sensor_twt_test_led_off;
        }
        if (now >= expires) break;
        if (!host_released && now >= release_at) {
#if defined(CONFIG_OFFGRID_NRF54_SENSOR_TWT_FORCE_SNOOZE)
            sensor_twt_force_snooze();
#endif
            if (mmdrv_set_wake_enabled(false) != MMWLAN_SUCCESS) goto done;
            sensor_halow_sleep_allowed = host_released = true;
            sensor_twt_test_host_released = 1;
            LOG_INF("PAWR_TWT host wake released; subsequent calibration runs only after RX");
#if defined(CONFIG_OFFGRID_NRF54_SENSOR_TWT_MAC_SNAPSHOT)
            sensor_twt_log_busy("host-release");
#endif
        }
        uint64_t deadline = led_until && led_until < expires ? led_until : expires;
#if defined(CONFIG_OFFGRID_NRF54_SENSOR_TWT_MAC_SNAPSHOT)
        if (snapshot_at < deadline) deadline = snapshot_at;
#endif
        if (!host_released && release_at < deadline) deadline = release_at;
        sensor_force_cpu_low_power();
        if (k_msgq_get(&sensor_twt_queue, &event, (deadline == UINT64_MAX ? K_FOREVER : K_USEC(deadline - now))) != 0) continue;
        if (memcmp(event.peer, sensor_probe_peer_mac, 6) ||
            !edgez_pawr_twt_same_schedule(&offer, &event.msg) ||
            event.msg.round_trip_us != offer.round_trip_us) continue;
        if (event.msg.kind == EDGEZ_PAWR_TWT_CANCEL) break;
        if (event.msg.kind != EDGEZ_PAWR_TWT_PROBE) continue;
        if (event.msg.echo_host_us <= last_probe_us) continue;
        last_probe_us = event.msg.echo_host_us;
        if (offer.lease_ms) expires = sensor_twt_now_us() + (uint64_t)offer.lease_ms * 1000;
        if ((event.msg.sequence & 0x7fffffffU) >= 30U ||
            !(event.msg.sequence & 0x80000000U)) continue;
        ++sensor_twt_test_user_rx;
        if (event.msg.sequence & 0x80000000U) {
            sensor_led_set_awake(true);
            led_until = sensor_twt_now_us() + 5000000;
            ++sensor_twt_test_led_on;
            LOG_INF("PAWR_TWT LED on P2.05; USER wake sequence=%u duration_ms=5000", event.msg.sequence);
        }
        bool off_window = event.msg.sequence & 1U;
        if (off_window) ++outside; else ++inside;
        LOG_INF("PAWR_TWT RX sequence=%u planned=%s host_us=%llu host_released=%u", event.msg.sequence,
            off_window ? "outside" : "inside", (unsigned long long)event.received_us, host_released);
        {
            bool feedback_sent = false;
            if (host_released && mmdrv_set_wake_enabled(true) != MMWLAN_SUCCESS) goto done;
            sensor_twt_test_host_released = 0;
            uint64_t before = sensor_twt_now_us(), tsf;
            if (!sensor_probe_get_tsf(&tsf)) goto done;
            uint64_t after = sensor_twt_now_us();
            uint64_t rx_tsf = tsf - ((before + after) / 2 - event.received_us);
            if (rx_tsf >= offer.target_tsf) {
                uint32_t phase = (rx_tsf - offer.target_tsf) % offer.interval_us;
                uint32_t expected = offer.duration_us / 2 + (off_window ? offer.interval_us / 2 : 0);
                int32_t error = (int32_t)phase - (int32_t)expected;
                if (error > (int32_t)offer.interval_us / 2) error -= offer.interval_us;
                if (error < -(int32_t)offer.interval_us / 2) error += offer.interval_us;
                LOG_INF("PAWR_TWT PACE sequence=%u radio_phase_us=%u expected_us=%u error_us=%d query_span_us=%llu",
                    event.msg.sequence, phase, expected, error, (unsigned long long)(after - before));
                uint64_t processing = sensor_twt_now_us() - event.received_us;
                if (after - before <= 10000 && processing > 0 && processing <= 10000 &&
                    error >= -20000 && error <= 20000) {
                    struct edgez_pawr_twt feedback = event.msg;
                    feedback.kind = EDGEZ_PAWR_TWT_HIT;
                    feedback.phase_error_us = error;
                    feedback.processing_us = (uint32_t)processing;
                    if (!sensor_twt_send(&feedback)) goto done;
                    feedback_sent = true;
                }

            }
            if (!feedback_sent) ++sensor_twt_test_feedback_skipped;
        }
#if defined(CONFIG_OFFGRID_NRF54_SENSOR_TWT_MAC_SNAPSHOT)
        if (sensor_twt_test_capture_after_user) sensor_twt_capture_mac();
#endif
        if (host_released) {
#if defined(CONFIG_OFFGRID_NRF54_SENSOR_TWT_FORCE_SNOOZE)
            sensor_twt_force_snooze();
#endif
            enum mmwlan_status released = mmdrv_set_wake_enabled(false);
            LOG_INF("PAWR_TWT POST_TX host_release_sdk=%d", released);
            if (released != MMWLAN_SUCCESS) goto done;
            sensor_twt_test_host_released = 1;
        }
        /* Timing feedback piggybacks on the USER request hash ACK. Current is measured externally;
         * no GPIO, BUSY or packet counters infer the RF sleep state. */
    }
    LOG_INF("PAWR_TWT EXPIRED received_inside=%u received_outside=%u", inside, outside);
 done:
    sensor_twt_test_active = 0;
    sensor_twt_test_host_released = 0;
    sensor_led_set_awake(false);
    (void)mmdrv_set_wake_enabled(true);
    sensor_halow_sleep_allowed = false;
    if (installed) (void)sensor_probe_twt_at(MORSE_CMD_ID_TWT_AGREEMENT_REMOVE, 0x1420, 0);
    if (offer.target_tsf) { offer.kind = EDGEZ_PAWR_TWT_CANCEL; (void)sensor_twt_send(&offer); k_msleep(20); }
    atomic_clear(&sensor_remote_wake_pending);
    k_sem_reset(&sensor_remote_wake_sem);
    LOG_INF("PAWR_TWT DONE; full radio shutdown clears experimental station/TWT state");
    return false;
}
